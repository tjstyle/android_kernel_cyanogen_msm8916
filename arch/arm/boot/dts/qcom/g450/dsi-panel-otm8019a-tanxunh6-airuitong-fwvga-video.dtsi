/* Copyright (c) 2013, The Linux Foundation. All rights reserved.
 *
 * This program is free software; you can redistribute it and/or modify
 * it under the terms of the GNU General Public License version 2 and
 * only version 2 as published by the Free Software Foundation.
 *
 * This program is distributed in the hope that it will be useful,
 * but WITHOUT ANY WARRANTY; without even the implied warranty of
 * MERCHANTABILITY or FITNESS FOR A PARTICULAR PURPOSE.  See the
 * GNU General Public License for more details.
 */

/*---------------------------------------------------------------------------
 * This file is autogenerated file using gcdb parser. Please do not edit it.
 * Update input XML file to add a new entry or update variable in this file
 * VERSION = "1.0"
 *---------------------------------------------------------------------------*/
&mdss_mdp {
	dsi_otm8019a_tanxunh6_airuitong_fwvga_video: qcom,mdss_dsi_otm8019a_tanxunh6_airuitong_fwvga_video {
		qcom,mdss-dsi-panel-name = "otm8019a fwvga video mode dsi panel";
		qcom,mdss-dsi-panel-controller = <&mdss_dsi0>;
		qcom,mdss-dsi-panel-type = "dsi_video_mode";
		qcom,mdss-dsi-panel-destination = "display_1";
		qcom,mdss-dsi-panel-framerate = <60>;
		qcom,mdss-dsi-virtual-channel-id = <0>;
		qcom,mdss-dsi-stream = <0>;
		qcom,mdss-dsi-panel-width = <480>;
		qcom,mdss-dsi-panel-height = <854>;
		qcom,mdss-dsi-h-front-porch = <120>;
		qcom,mdss-dsi-h-back-porch = <120>;
		qcom,mdss-dsi-h-pulse-width = <10>;
		qcom,mdss-dsi-h-sync-skew = <0>;
		qcom,mdss-dsi-v-back-porch = <20>;
		qcom,mdss-dsi-v-front-porch = <20>;
		qcom,mdss-dsi-v-pulse-width = <10>;
		qcom,mdss-dsi-h-left-border = <0>;
		qcom,mdss-dsi-h-right-border = <0>;
		qcom,mdss-dsi-v-top-border = <0>;
		qcom,mdss-dsi-v-bottom-border = <0>;
		qcom,mdss-dsi-bpp = <24>;
		qcom,mdss-dsi-color-order = <0>;
		qcom,mdss-dsi-underflow-color = <0xff>;
		qcom,mdss-dsi-border-color = <0>;
		qcom,mdss-pan-physical-width-dimension = <56>;
		qcom,mdss-pan-physical-height-dimension = <100>;
		qcom,mdss-dsi-on-command = [					
39 01 00 00 00 00 02 00 00
39 01 00 00 00 00 04 FF 80 19 01
39 01 00 00 00 00 02 00 80
39 01 00 00 00 00 03 FF 80 19
39 01 00 00 00 00 02 00 B4
39 01 00 00 00 00 02 C0 70
39 01 00 00 00 00 02 00 81
39 01 00 00 00 00 02 C5 66
39 01 00 00 00 00 02 00 82
39 01 00 00 00 00 02 C5 B0
39 01 00 00 00 00 02 00 90
39 01 00 00 00 00 03 C5 4E 9d
39 01 00 00 00 00 02 00 00
39 01 00 00 00 00 03 D8 69 69
39 01 00 00 00 00 02 00 00
39 01 00 00 00 00 02 D9 60
39 01 00 00 00 00 02 00 81
39 01 00 00 00 00 02 C1 33
39 01 00 00 00 00 02 00 A1
39 01 00 00 00 00 02 C1 08
39 01 00 00 00 00 02 00 81
39 01 00 00 00 00 02 C4 83
39 01 00 00 00 00 02 00 B1
39 01 00 00 00 00 02 C5 A9
39 01 00 00 00 00 02 00 93
39 01 00 00 00 00 02 C5 03
39 01 00 00 00 00 02 00 92
39 01 00 00 00 00 02 B3 40
39 01 00 00 00 00 02 00 90
39 01 00 00 00 00 02 B3 02
39 01 00 00 00 00 02 00 80
39 01 00 00 00 00 0a C0 00 58 00 15 15 00 58 15 15
39 01 00 00 00 00 02 00 90
39 01 00 00 00 00 07 C0 00 15 00 00 00 03
39 01 00 00 00 00 02 00 80
39 01 00 00 00 00 0d CE 8B 03 00 8A 03 00 89 03 00 88 03 00
39 01 00 00 00 00 02 00 A0
39 01 00 00 00 00 0f CE 38 07 03 54 00 0f 00 38 06 03 55 00 0f 00
39 01 00 00 00 00 02 00 B0
39 01 00 00 00 00 0f CE 38 05 03 56 00 0f 00 38 04 03 57 00 0f 00
39 01 00 00 00 00 02 00 C0
39 01 00 00 00 00 0f CE 38 03 03 58 00 0f 00 38 02 03 59 00 0f 00
39 01 00 00 00 00 02 00 D0
39 01 00 00 00 00 0f CE 38 01 03 5A 00 0f 00 38 00 03 5B 00 0f 00
39 01 00 00 00 00 02 00 C0
39 01 00 00 00 00 0b CF 02 02 00 00 00 00 01 00 00 00
39 01 00 00 00 00 02 00 90
39 01 00 00 00 00 10 CB 00 00 00 00 00 00 00 00 00 00 00 00 00 00 00
39 01 00 00 00 00 02 00 A0
39 01 00 00 00 00 02 CB 00
39 01 00 00 00 00 02 00 A5
39 01 00 00 00 00 0b CB 00 00 00 00 00 00 00 00 00 00
39 01 00 00 00 00 02 00 B0
39 01 00 00 00 00 07 CB 00 00 00 00 00 00
39 01 00 00 00 00 02 00 C0
39 01 00 00 00 00 10 CB 01 01 01 01 01 01 01 01 01 01 00 00 00 00 00
39 01 00 00 00 00 02 00 D0
39 01 00 00 00 00 02 CB 00
39 01 00 00 00 00 02 00 D5
39 01 00 00 00 00 0b CB 00 00 00 00 00 00 01 01 01 01
39 01 00 00 00 00 02 00 E0
39 01 00 00 00 00 07 CB 01 01 01 01 01 01
39 01 00 00 00 00 02 00 80
39 01 00 00 00 00 0b CC 26 25 21 22 0C 0A 10 0E 02 04
39 01 00 00 00 00 02 00 90
39 01 00 00 00 00 10 CC 00 00 00 00 00 00 00 00 00 00 00 00 00 00 00
39 01 00 00 00 00 02 00 A0
39 01 00 00 00 00 0c CC 00 03 01 0D 0F 09 0B 22 21 25 26
39 01 00 00 00 00 02 00 B0
39 01 00 00 00 00 0b CC 25 26 21 22 10 0A 0C 0E 04 02
39 01 00 00 00 00 02 00 C0
39 01 00 00 00 00 07 CC 00 00 00 00 00 00
39 01 00 00 00 00 02 00 CA
39 01 00 00 00 00 06 CC 00 00 00 00 00
39 01 00 00 00 00 02 00 D0
39 01 00 00 00 00 0c CC 00 01 03 0D 0B 09 0F 22 21 26 25
39 01 00 00 00 00 02 00 00
39 01 00 00 00 00 15 E1 00 02 06 11 24 38 41 75 67 7f 86 74 8b 75 79 71 69 58 4d 00
39 01 00 00 00 00 02 00 00
39 01 00 00 00 00 15 E2 00 02 06 11 24 38 41 75 68 7f 86 74 8b 74 79 70 68 58 4e 00
39 01 00 00 00 00 02 00 80
39 01 00 00 00 00 02 C4 30
39 01 00 00 00 00 02 00 98
39 01 00 00 00 00 02 C0 00
39 01 00 00 00 00 02 00 a9
39 01 00 00 00 00 02 C0 0A
39 01 00 00 00 00 02 00 b0
39 01 00 00 00 00 04 C1 20 00 00
39 01 00 00 00 00 02 00 e1
39 01 00 00 00 00 03 C0 40 30
39 01 00 00 00 00 02 00 80
39 01 00 00 00 00 03 C1 03 33
39 01 00 00 00 00 02 00 A0
39 01 00 00 00 00 02 C1 e8
39 01 00 00 00 00 02 00 90
39 01 00 00 00 00 02 b6 b4
39 01 00 00 00 00 02 00 00
39 01 00 00 00 00 02 fb 01
39 01 00 00 00 00 02 00 00
39 01 00 00 00 00 04 FF FF FF FF
39 01 00 00 00 00 02 35 00
39 01 00 00 00 00 02 3A 77
39 01 00 00 00 00 02 36 00
39 01 00 00 78 00 02 11 00
39 01 00 00 3a 00 02 29 00
 ];
		qcom,mdss-dsi-off-command = [05 01 00 00 0A 00 02 28 00
					05 01 00 00 78 00 02 10 00];
		qcom,mdss-dsi-on-command-state = "dsi_lp_mode";
		qcom,mdss-dsi-off-command-state = "dsi_hs_mode";
		qcom,mdss-dsi-h-sync-pulse = <1>;
		qcom,mdss-dsi-traffic-mode = <2>;
		qcom,mdss-dsi-lane-map = <0>;
		qcom,mdss-dsi-bllp-eof-power-mode;
		qcom,mdss-dsi-bllp-power-mode;
		qcom,mdss-dsi-lane-0-state;
		qcom,mdss-dsi-lane-1-state;
		qcom,mdss-dsi-panel-timings = [86 1e 14 00 42 46 18 20 16 03 04 00];
		qcom,mdss-dsi-t-clk-post = <0x1f>;
		qcom,mdss-dsi-t-clk-pre = <0x2d>;
		qcom,mdss-dsi-bl-min-level = <1>;
		qcom,mdss-dsi-bl-max-level = <4095>;
		qcom,mdss-dsi-dma-trigger = <4>;
		qcom,mdss-dsi-mdp-trigger = <0>;
		qcom,mdss-dsi-bl-pmic-control-type = "bl_ctrl_pwm";
		qcom,mdss-dsi-bl-pmic-pwm-frequency = <100>;
		qcom,mdss-dsi-bl-pmic-bank-select = <0>;
		qcom,mdss-dsi-pwm-gpio = <&pm8916_mpps 4 0>;
		qcom,mdss-dsi-reset-sequence = <1 20>, <0 20>, <1 120>;
		qcom,mdss-dsi-lp11-init;
//		qcom,cont-splash-enabled;
//		qcom,mdss-dsi-init-delay-us = <1000>;
	};
};


